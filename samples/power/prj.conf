## CMakeLists.txt
```
#
# Copyright (c) 2019 Nordic Semiconductor ASA
#
# SPDX-License-Identifier: LicenseRef-BSD-5-Clause-Nordic
#
cmake_minimum_required(VERSION 3.13.1)

find_package(Zephyr REQUIRED HINTS $ENV{ZEPHYR_BASE})
project(power)

FILE(GLOB app_sources src/*.c)
target_sources(app PRIVATE
	${app_sources}
)
```

## sample.yaml
```
sample:
  name: Power Management
  description: Power Management sample
tests:
  samples.power:
    build_only: true
    build_on_all: true
    platform_allow: nrf52dk_nrf52832 nrf52833dk_nrf52833 nrf52840dk_nrf52840 nrf9160dk_nrf9160
                    nrf5340dk_nrf5340_cpuapp nrf5340pdk_nrf5340_cpuapp
    tags: ci_build
```

## prj.conf
```kconfig
#
# Copyright (c) 2020 Nordic Semiconductor
#
# SPDX-License-Identifier: LicenseRef-BSD-5-Clause-Nordic
#

CONFIG_NRFX_UARTE0=y
CONFIG_NRFX_PM=y
CONFIG_NRFX_RTN=y
CONFIG_USE_SEGGER_RTT=n
CONFIG_LOG=y
#CONFIG_NO_OPTIMIZATIONS=y
CONFIG_ASSERT=y
```

## src/main.c
```c
/*$$$LICENCE_NORDIC_STANDARD<2020>$$$*/

#include <zephyr.h>
#include <stdbool.h>
#include <stdint.h>
#include <nrfx_uarte.h>

#define UARTE(idx)                      DT_NODELABEL(uart##idx)

nrfx_uarte_config_t conf = NRFX_UARTE_DEFAULT_CONFIG(6, 8);
nrfx_uarte_t inst = NRFX_UARTE_INSTANCE(0);
static void * p_pm_uarte;

void pm_event_handler(nrfx_pm_event_t event)
{
    ;
}

void uart_handler(nrfx_uarte_event_t const * p_event, void * p_context)
{
    ;
}

int main(void)
{
    uint8_t const a[] = "before\r\n";
    uint8_t const b[] = "after\r\n";

    IRQ_CONNECT(DT_IRQN(UARTE(0)), DT_IRQ(UARTE(0), priority),
                nrfx_uarte_0_irq_handler, 0, 0);
    irq_enable(DT_IRQN(UARTE(0)));
    nrfx_uarte_init(&inst, &conf, uart_handler);

    p_pm_uarte = nrfx_uarte_pm_get(&inst);

    if (nrfx_pm_init(p_pm_uarte, pm_event_handler) != NRFX_SUCCESS)
    {
        while (1)
        {}
    }

    nrfx_uarte_tx(&inst, &a[0], sizeof(a));

    /* Wait for middle of transmission. */
    k_sleep(K_USEC(1000));

    if (nrfx_pm_power_off(p_pm_uarte, true) != NRFX_SUCCESS)
    {
        while (1)
        {}
    }

    k_sleep(K_USEC(1000000));

    if (nrfx_pm_power_on(p_pm_uarte) != NRFX_SUCCESS)
    {
        while (1)
        {}
    }

    nrfx_uarte_tx(&inst, &b[0], sizeof(b));
    while (1)
    {
        k_sleep(K_USEC(1000000));
    }
}
```
